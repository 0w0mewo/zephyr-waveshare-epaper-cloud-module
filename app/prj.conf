## CMakeLists.txt
```
# SPDX-License-Identifier: Apache-2.0

cmake_minimum_required(VERSION 3.20.0)

find_package(Zephyr REQUIRED HINTS $ENV{ZEPHYR_BASE})
project(wifi_hello_world)

zephyr_include_directories(includes)
FILE(GLOB app_sources src/*.c)
target_sources(app PRIVATE ${app_sources})
```

## Kconfig
```
source "Kconfig.zephyr"

config SSID
    string "ssid"
    default ""

config PSK
    string "psk"
    default ""

config MY_SNTP_SERVER
    string "sntp server"
    default ""
```

## prj.conf
```kconfig
CONFIG_NETWORKING=y
CONFIG_ENTROPY_GENERATOR=y
CONFIG_USE_SEGGER_RTT=n
CONFIG_RTT_CONSOLE=n
CONFIG_DISPLAY=y
CONFIG_LVGL=y

# L2 - wifi settings
CONFIG_WIFI=y
CONFIG_NET_L2_WIFI_MGMT=y
CONFIG_NET_DEFAULT_IF_WIFI=y
CONFIG_WIFI_NM=y
CONFIG_WIFI_NM_MAX_MANAGED_INTERFACES=1

# wifi ssid and password for testing
CONFIG_SSID="my ap"
CONFIG_PSK="my password"

# IP stack settings
CONFIG_NET_IPV4=y
CONFIG_NET_IPV6=n
CONFIG_NET_HOSTNAME_ENABLE=y
CONFIG_NET_HOSTNAME="zephyr-wifi-esp32-test"
CONFIG_NET_DHCPV4=y
CONFIG_NET_DHCPV4_OPTION_NTP_SERVER=n
CONFIG_NET_CONFIG_SETTINGS=n # let wifi NM to handle IP config
CONFIG_NET_CONNECTION_MANAGER=y # enable more abstracted L4 connectivity event manager

# L4/socket settings
CONFIG_NET_TCP=y

# network packet buffering sizes
CONFIG_NET_TX_STACK_SIZE=2048
CONFIG_NET_RX_STACK_SIZE=2048
CONFIG_NET_PKT_RX_COUNT=10
CONFIG_NET_PKT_TX_COUNT=10
CONFIG_NET_BUF_RX_COUNT=20
CONFIG_NET_BUF_TX_COUNT=20
CONFIG_NET_MAX_CONTEXTS=10

# L7 settings
# dns server address is obtained from DHCP
CONFIG_DNS_RESOLVER=y
CONFIG_DNS_RESOLVER_ADDITIONAL_BUF_CTR=2
CONFIG_DNS_RESOLVER_MAX_SERVERS=1
CONFIG_NET_SOCKETS_DNS_TIMEOUT=5000

# sntp
CONFIG_SNTP=y
CONFIG_MY_SNTP_SERVER="0.pool.ntp.org"

# OS misc
CONFIG_LOG=y
CONFIG_NET_LOG=y
CONFIG_WIFI_LOG_LEVEL_WRN=y
CONFIG_NET_CONFIG_LOG_LEVEL_WRN=y
CONFIG_INIT_STACKS=y
CONFIG_MAIN_STACK_SIZE=2048
CONFIG_SYSTEM_WORKQUEUE_STACK_SIZE=4096

# LVGL
CONFIG_LV_COLOR_DEPTH_1=y
CONFIG_LV_DPI_DEF=148
CONFIG_LV_CONF_MINIMAL=y
CONFIG_LV_FONT_DEFAULT_UNSCII_8=y
CONFIG_LV_USE_THEME_MONO=y
CONFIG_LV_USE_LABEL=y
CONFIG_LV_USE_CANVAS=y
# CONFIG_LV_LOG_LEVEL_INFO=y
# CONFIG_LV_USE_LOG=y

# LVGL on zephyr port settings
CONFIG_LV_Z_MEM_POOL_SYS_HEAP=y
CONFIG_LV_Z_MEM_POOL_SIZE=8192
CONFIG_LV_Z_COLOR_MONO_HW_INVERSION=y
CONFIG_LV_Z_VDB_SIZE=64
```

## socs/esp32_procpu.conf
```kconfig
CONFIG_ESP32_WIFI_STA_AUTO_DHCPV4=y
CONFIG_ESP32_WIFI_STA_RECONNECT=y
```

## src/main.c
```c
#include <game_of_life.h>
#include <time.h>
#include <ui/ui.h>
#include <utils/wifi.h>
#include <zephyr/device.h>
#include <zephyr/drivers/display.h>
#include <zephyr/kernel.h>
#include <zephyr/logging/log.h>

LOG_MODULE_REGISTER(main, LOG_LEVEL_INF);

static int display_init(const struct device *disp_dev);

/* get SYS_CLOCK_REALTIME time as human readable string*/
static int sysclock_time_txt(char *strbuf, size_t size);

#define SMALL_STRBUF_SIZE 64

static const struct device *const disp_dev = DEVICE_DT_GET(DT_CHOSEN(zephyr_display));
static struct game_of_life world;
static uint32_t world_checksum = 0;

static void cell_update_callback(size_t x, size_t y, uint8_t cell_state) {
	if (cell_state == CELL_STATE_ALIVE_PRESENT) {
		ui_canvas_set_px(x, y);
	} else {
		ui_canvas_clear_px(x, y);
	}

	world_checksum += cell_state * (x + y);
}

int main(void) {
	int ret = 0;
	uint32_t last_world_checksum = 0;
	uint8_t steady_count = 0;

	char *strbuf = k_malloc(SMALL_STRBUF_SIZE);
	if (strbuf == NULL) {
		LOG_ERR("no memory on heap");
		return -ENOMEM;
	}

	ui_init();
	k_msleep(100);	// wait for ui initialised

	game_of_life_init(&world, CANVAS_WIDTH, CANVAS_HEIGHT);
	game_of_life_set_cell_update_callback(&world, cell_update_callback);
	game_of_life_reset(&world);

	ui_set_time_txt("connecting...");
	ui_canvas_fill_noise();
	wifi_simple_connect();

	ret = wifi_simple_wait_online();
	if (ret < 0) {
		LOG_ERR("fail to connect to internet");
		ui_set_time_txt("offline");

	} else {
		LOG_INF("connected to internet");
	}

	for (;;) {
		// print time on display every minute
		if (sysclock_is_synced()) {
			sysclock_time_txt(strbuf, SMALL_STRBUF_SIZE);
		} else {
			strncpy(strbuf, "SNTP error", SMALL_STRBUF_SIZE);
		}
		ui_set_time_txt(strbuf);

		// update game of life world state
		game_of_life_update(&world);
		if (world_checksum == last_world_checksum) {
			steady_count++;
		}
		if (steady_count > 3) {
			game_of_life_reset(&world);
			steady_count = 0;
		}
		last_world_checksum = world_checksum;
		world_checksum = 0;

		k_sleep(K_SECONDS(60));
	}

	k_free(strbuf);
	game_of_life_deinit(&world);

	return ret;
}

static int sysclock_time_txt(char *strbuf, size_t size) {
	struct timespec ts;

	int ret = sys_clock_gettime(SYS_CLOCK_REALTIME, &ts);
	if (ret < 0) {
		LOG_ERR("fail to get sysclock: %d", ret);
		return ret;
	}

	struct tm *t = localtime(&ts.tv_sec);
	strftime(strbuf, size, "%Y-%m-%d\n%H:%M:%S", t);

	return 0;
}

static int display_fill_white(const struct device *disp_dev) {
	struct display_capabilities cap;
	display_get_capabilities(disp_dev, &cap);

	uint32_t fb_size = cap.x_resolution * cap.y_resolution / 8;
	uint8_t *zeros = k_malloc(fb_size);
	if (zeros == NULL) {
		return -ENOMEM;
	}
	memset(zeros, 0xff, fb_size);

	struct display_buffer_descriptor desc = {
		.buf_size = fb_size,
		.frame_incomplete = false,
		.height = cap.y_resolution,
		.width = cap.x_resolution,
		.pitch = cap.x_resolution,
	};
	display_write(disp_dev, 0, 0, &desc, zeros);

	k_free(zeros);
	return 0;
}

static int display_init(const struct device *disp_dev) {
	if (!device_is_ready(disp_dev)) {
		return -ENODEV;
	}

	// set pixel format to Monochrome
	if (display_set_pixel_format(disp_dev, PIXEL_FORMAT_MONO10) != 0) {
		if (display_set_pixel_format(disp_dev, PIXEL_FORMAT_MONO01) != 0) {
			return -ENOTSUP;
		}
	}

	// clear the screen
	display_fill_white(disp_dev);

	return 0;
}

static int app_perh_init(void) {
	int ret;

	ret = display_init(disp_dev);
	if (ret < 0) {
		return ret;
	}

	wifi_simple_init();

	return 0;
}

SYS_INIT(app_perh_init, APPLICATION, 42);
```

## src/game_of_life.c
```c
#include <game_of_life.h>
#include <zephyr/kernel.h>
#include <zephyr/logging/log.h>
#include <zephyr/random/random.h>

LOG_MODULE_REGISTER(game_of_life, LOG_LEVEL_INF);

// how many cells can be encoded in one byte
#define CELLS_PER_BYTE (BITS_PER_BYTE / CELL_STATE_MAX)

// how many bits to encode a cell state
#define BITS_PER_CELL (LOG2CEIL(CELL_STATE_MAX))

int game_of_life_init(struct game_of_life *w, size_t cols, size_t rows) {
	w->size = ROUND_UP(rows * cols, CELLS_PER_BYTE) / CELLS_PER_BYTE;
	w->cells = (uint8_t *)k_malloc(w->size);
	if (w->cells == NULL) {
		return -ENOMEM;
	}
	w->col_max = cols;
	w->row_max = rows;
	memset(w->cells, CELL_STATE_DEAD_PRESENT, w->size);

	LOG_INF("allocated %d byte for the world\n", w->size);
	LOG_INF("world size: %dx%d", w->row_max, w->col_max);
	return 0;
}

void game_of_life_reset(struct game_of_life *w) {
	for (size_t y = 0; y < w->row_max; y++) {
		for (size_t x = 0; x < w->col_max; x++) {
			uint8_t random_cell_state = sys_rand8_get() > 128 ? CELL_STATE_ALIVE_PRESENT : CELL_STATE_DEAD_PRESENT;
			game_of_life_set_cell(w, x, y, random_cell_state);
		}
	}
}

void game_of_life_deinit(struct game_of_life *w) {
	k_free(w->cells);
}

static int game_of_life_get_cell_index(struct game_of_life *w, size_t x, size_t y, size_t *bit_idx, size_t *byte_idx) {
	size_t cell_idx = (w->col_max * y + x);
	*byte_idx = (cell_idx * BITS_PER_CELL) / BITS_PER_BYTE;
	*bit_idx = (cell_idx * BITS_PER_CELL) % BITS_PER_BYTE;

	return ((*byte_idx < w->size) ? 0 : -EINVAL);
}

uint8_t game_of_life_get_cell(struct game_of_life *w, size_t x, size_t y) {
	if (x >= w->col_max || y >= w->row_max) {
		return CELL_STATE_MAX;
	}

	size_t byte_idx, bit_idx;
	if (game_of_life_get_cell_index(w, x, y, &bit_idx, &byte_idx) < 0) {
		LOG_DBG("get cell out of range");

		return CELL_STATE_MAX;
	}

	uint8_t byte = w->cells[byte_idx];
	uint8_t cell_state = (IS_BIT_SET(byte, bit_idx) << 1) + IS_BIT_SET(byte, bit_idx + 1);
	return cell_state;
}

void game_of_life_set_cell(struct game_of_life *w, size_t x, size_t y, uint8_t cell_state) {
	if (x >= w->col_max || y >= w->row_max || cell_state >= CELL_STATE_MAX) {
		return;
	}

	size_t byte_idx, bit_idx;
	if (game_of_life_get_cell_index(w, x, y, &bit_idx, &byte_idx) < 0) {
		LOG_DBG("set cell out of range");

		return;
	}

	WRITE_BIT(w->cells[byte_idx], bit_idx, (cell_state & 0b10) >> 1);
	WRITE_BIT(w->cells[byte_idx], bit_idx + 1, cell_state & 0b01);
}

static size_t game_of_life_cell_neigbors_count(struct game_of_life *w, size_t x, size_t y) {
	size_t live = 0;
	/*
		x: neigbors, o: self
		x x x
		x o x
		x x x
	*/
	for (int8_t dy = -1; dy < 2; dy++) {
		for (int8_t dx = -1; dx < 2; dx++) {
			// ignore itself
			if (dx == 0 && dy == 0) {
				continue;
			}

			uint8_t cell_state = game_of_life_get_cell(w, x + dx, y + dy);
			if (cell_state != CELL_STATE_MAX) {
				if (cell_state == CELL_STATE_ALIVE_PRESENT || cell_state == CELL_STATE_DEAD_NEXT) {
					live++;
				}
			}
		}
	}

	return live++;
}

static uint8_t cell_state_rule(uint8_t state, size_t neigbors_count) {
	if (state == CELL_STATE_ALIVE_PRESENT) {
		if (neigbors_count < 2 || neigbors_count > 3) {
			return CELL_STATE_DEAD_NEXT;
		}
	} else if (state == CELL_STATE_DEAD_PRESENT) {
		if (neigbors_count == 3) {
			return CELL_STATE_ALIVE_NEXT;
		}
	}

	return state;
}

void game_of_life_update(struct game_of_life *w) {
	for (size_t y = 0; y < w->row_max; y++) {
		for (size_t x = 0; x < w->col_max; x++) {
			size_t alives = game_of_life_cell_neigbors_count(w, x, y);
			uint8_t next_state = cell_state_rule(game_of_life_get_cell(w, x, y), alives);
			game_of_life_set_cell(w, x, y, next_state);
		}
	}

	for (size_t y = 0; y < w->row_max; y++) {
		for (size_t x = 0; x < w->col_max; x++) {
			uint8_t cell_state = game_of_life_get_cell(w, x, y);
			if (cell_state == CELL_STATE_ALIVE_NEXT) {
				cell_state = CELL_STATE_ALIVE_PRESENT;
			}
			if (cell_state == CELL_STATE_DEAD_NEXT) {
				cell_state = CELL_STATE_DEAD_PRESENT;
			}

			game_of_life_set_cell(w, x, y, cell_state);

			if (w->cell_update_cb != NULL) {
				w->cell_update_cb(x, y, cell_state);
			}
		}
	}
}
void game_of_life_set_cell_update_callback(struct game_of_life *w, game_of_life_cb_t cb) {
	w->cell_update_cb = cb;
}
```

## src/ui.c
```c
#include <lvgl.h>
#include <ui/ui.h>
#include <zephyr/kernel.h>
#include <zephyr/logging/log.h>
#include <zephyr/random/random.h>

LOG_MODULE_REGISTER(myui, LOG_LEVEL_INF);

struct main_window {
	lv_obj_t *root;
	lv_obj_t *time_txt;
	lv_obj_t *canvas;
} main_win;

static void lvgl_update_work_handler(struct k_work *work);
K_WORK_DELAYABLE_DEFINE(lvgl_update_work, lvgl_update_work_handler);
K_MUTEX_DEFINE(lvgl_mu);
lv_draw_buf_t *canvas_buf;

static const lv_color32_t black = {
	.alpha = 0,
	.blue = 0,
	.green = 0,
	.red = 0,
};

static const lv_color32_t white = {
	.alpha = 255,
	.blue = 0,
	.green = 0,
	.red = 0,
};

static int ui_create(lv_obj_t *screen_handle) {
	main_win.root = screen_handle;

	main_win.canvas = lv_canvas_create(main_win.root);
	if (main_win.canvas == NULL) {
		LOG_ERR("fail to create canvas");
		return -ENOMEM;
	}
	canvas_buf = lv_draw_buf_create(CANVAS_WIDTH, CANVAS_HEIGHT, LV_COLOR_FORMAT_I1, 0);
	if (canvas_buf == NULL) {
		LOG_ERR("fail to create canvas buffer");
		return -ENOMEM;
	}
	lv_canvas_set_draw_buf(main_win.canvas, canvas_buf);
	lv_obj_align(main_win.canvas, LV_ALIGN_DEFAULT, 0, 0);
	lv_canvas_set_palette(main_win.canvas, 0, black);
	lv_canvas_set_palette(main_win.canvas, 1, white);
	lv_canvas_fill_bg(main_win.canvas, lv_color_black(), LV_OPA_COVER);

	main_win.time_txt = lv_label_create(main_win.root);
	if (main_win.time_txt == NULL) {
		LOG_ERR("fail to create time label");
		return -ENOMEM;
	}
	lv_obj_align_to(main_win.time_txt, main_win.canvas, LV_ALIGN_TOP_LEFT, 0, 0);
	lv_obj_set_y(main_win.time_txt, CANVAS_HEIGHT + 2);

	return 0;
}

int ui_init(void) {
	int ret = 0;
	ret = ui_create(lv_screen_active());
	if (ret < 0) {
		return ret;
	}

	k_work_schedule(&lvgl_update_work, K_NO_WAIT);

	return 0;
}

void ui_set_time_txt(const char *txt) {
	if (main_win.time_txt == NULL) {
		return;
	}

	lv_label_set_text(main_win.time_txt, txt);
}

void ui_canvas_set_px(int x, int y) {
	if (main_win.canvas == NULL) {
		return;
	}

	lv_canvas_set_px(main_win.canvas, x, y, lv_color_white(), LV_OPA_100);
}

void ui_canvas_clear_px(int x, int y) {
	if (main_win.canvas == NULL) {
		return;
	}

	lv_canvas_set_px(main_win.canvas, x, y, lv_color_black(), LV_OPA_100);
}

void ui_canvas_fill_noise(void) {
	for (int y = 0; y < CANVAS_HEIGHT; y++) {
		for (int x = 0; x < CANVAS_WIDTH; x++) {
			if (sys_rand8_get() > 127) {
				ui_canvas_set_px(x, y);
			} else {
				ui_canvas_clear_px(x, y);
			}
		}
	}
}

static void lvgl_update_work_handler(struct k_work *work) {
	struct k_work_delayable *dwork = k_work_delayable_from_work(work);

	k_mutex_lock(&lvgl_mu, K_FOREVER);
	uint32_t sleep_ms = lv_timer_handler();
	k_mutex_unlock(&lvgl_mu);

	if (sleep_ms == LV_NO_TIMER_READY) {
		sleep_ms = CONFIG_LV_DEF_REFR_PERIOD;
	}

	k_work_schedule(dwork, K_MSEC(sleep_ms));
}
```

## src/wifi.c
```c
#include <utils/wifi.h>
#include <zephyr/kernel.h>
#include <zephyr/logging/log.h>
#include <zephyr/net/net_event.h>
#include <zephyr/net/net_if.h>
#include <zephyr/net/net_l2.h>
#include <zephyr/net/net_mgmt.h>
#include <zephyr/net/sntp.h>
#include <zephyr/net/wifi_mgmt.h>

LOG_MODULE_REGISTER(wifi_utils, LOG_LEVEL_INF);

#define L4_EVENT_MASK (NET_EVENT_L4_CONNECTED | NET_EVENT_L4_DISCONNECTED)
#define WIFI_SCAN_EVENT_MASK (NET_EVENT_WIFI_SCAN_RESULT | NET_EVENT_WIFI_SCAN_DONE)

#define MAX_WIFI_SCAN_RESULTS 10
#define MAX_WIFI_SCAN_TIME_SEC 20
#define MAX_WIFI_INET_WAIT_SEC 200

#define FMT_MAC_ADDR "%x:%x:%x:%x:%x:%x"
#define MAC_ADDR(x) x[0], x[1], x[2], x[3], x[4], x[5]

enum {
	WIFI_SIMPLE_CONNECTED,
	WIFI_SIMPLE_SNTP_RESYNCED,
};

struct wifi_simple_scan_results {
	struct wifi_scan_result *res;
	uint8_t count;
	struct k_mutex mu;
};

static int wifi_simple_scan_results_init(struct wifi_simple_scan_results *scan_results) {
	scan_results->res = k_malloc(MAX_WIFI_SCAN_RESULTS * sizeof(struct wifi_scan_result));
	if (scan_results->res == NULL) {
		LOG_ERR("fail to allocate memory for wifi scan results");
		return -ENOMEM;
	}

	k_mutex_init(&scan_results->mu);
	scan_results->count = 0;

	return 0;
}

static void wifi_simple_scan_results_deinit(struct wifi_simple_scan_results *scan_results) {
	k_free(scan_results->res);
}

static void wifi_simple_scan_results_reset(struct wifi_simple_scan_results *scan_results) {
	memset(scan_results->res, 0, MAX_WIFI_SCAN_RESULTS * sizeof(struct wifi_scan_result));
	scan_results->count = 0;
}

K_SEM_DEFINE(inet_ready, 0, 1);
K_SEM_DEFINE(scan_done, 0, 1);

static atomic_t flags;
static struct wifi_simple_scan_results scan_results;

static void sysclock_resync_work_handler(struct k_work *work);
K_WORK_DELAYABLE_DEFINE(sysclock_resync_work, sysclock_resync_work_handler);

void wifi_simple_connect(void) {
	struct net_if *iface = net_if_get_first_wifi();
	if (iface == NULL) {
		LOG_ERR("no wifi intf");
		return;
	}

	struct wifi_connect_req_params wifi_params = {
		.ssid = CONFIG_SSID,
		.psk = CONFIG_PSK,
		.ssid_length = strlen(CONFIG_SSID),
		.psk_length = strlen(CONFIG_PSK),
		.channel = WIFI_CHANNEL_ANY,
		.security = WIFI_SECURITY_TYPE_PSK,
		.band = WIFI_FREQ_BAND_2_4_GHZ,
		.mfp = WIFI_MFP_OPTIONAL,
	};

	if (net_mgmt(NET_REQUEST_WIFI_CONNECT, iface, &wifi_params, sizeof(struct wifi_connect_req_params))) {
		LOG_ERR("NET_REQUEST_WIFI_CONNECT failed");
	}
}

void wifi_simple_disconnect(void) {
	struct net_if *iface = net_if_get_first_wifi();
	if (iface == NULL) {
		LOG_ERR("no wifi intf");
		return;
	}

	if (net_mgmt(NET_REQUEST_WIFI_DISCONNECT, iface, NULL, 0)) {
		LOG_ERR("NET_REQUEST_WIFI_DISCONNECT failed");
	}
}

static void handle_connect(void) {
	LOG_INF("network connected");

	// sync systime without wait
	k_work_reschedule(&sysclock_resync_work, K_NO_WAIT);
}

static void handle_disconnect(void) {
	LOG_INF("network disconnected");

	// cancel further systime resync task
	k_work_cancel_delayable(&sysclock_resync_work);
}

static struct net_mgmt_event_callback inet_connectivity_cb;
static void inet_connectivity_handler(struct net_mgmt_event_callback *cb, uint64_t mgmt_event, struct net_if *iface) {
	if ((mgmt_event & L4_EVENT_MASK) != mgmt_event) {
		return;
	}

	switch (mgmt_event) {
		case NET_EVENT_L4_CONNECTED: {
			atomic_set_bit(&flags, WIFI_SIMPLE_CONNECTED);
			k_sem_give(&inet_ready);

			handle_connect();
		} break;

		case NET_EVENT_L4_DISCONNECTED: {
			atomic_clear_bit(&flags, WIFI_SIMPLE_CONNECTED);
			k_sem_reset(&inet_ready);

			handle_disconnect();
		} break;

		default:
			break;
	}
}

static struct net_mgmt_event_callback wifi_scan_cb;
static void wifi_scan_event_handler(struct net_mgmt_event_callback *cb, uint64_t mgmt_event, struct net_if *iface) {
	if ((mgmt_event & WIFI_SCAN_EVENT_MASK) != mgmt_event) {
		return;
	}

	switch (mgmt_event) {
		case NET_EVENT_WIFI_SCAN_DONE: {
			k_sem_give(&scan_done);
		} break;

		case NET_EVENT_WIFI_SCAN_RESULT: {
			k_mutex_lock(&scan_results.mu, K_FOREVER);
			if (scan_results.count < MAX_WIFI_SCAN_RESULTS) {
				const struct wifi_scan_result *res = (const struct wifi_scan_result *)cb->info;

				memcpy(&scan_results.res[scan_results.count], res, MIN(cb->info_length, sizeof(struct wifi_scan_result)));
				scan_results.count++;
			} else {
				LOG_WRN("dropping scan results");
			}
			k_mutex_unlock(&scan_results.mu);
		} break;

		default:
			break;
	}
}

int wifi_simple_print_scan(void) {
	int ret;
	const struct wifi_scan_params scan_params = {0};
	struct net_if *iface = net_if_get_first_wifi();

	// it's an one shot operation, so we register and unregister the event callback
	// while scan starts and scan finishes
	net_mgmt_add_event_callback(&wifi_scan_cb);

	ret = wifi_simple_scan_results_init(&scan_results);
	if (ret < 0) {
		goto exit_nomem;
	}

	if (net_mgmt(NET_REQUEST_WIFI_SCAN, iface, (void *)(&scan_params), sizeof(scan_params)) < 0) {
		ret = -EIO;
		goto exit;
	}

	LOG_INF("scan requested, waitting for results");
	if (k_sem_take(&scan_done, K_SECONDS(MAX_WIFI_SCAN_TIME_SEC)) < 0) {
		ret = -ETIMEDOUT;
		goto exit;
	}

	LOG_INF("found %d APs", scan_results.count);

	struct wifi_scan_result *res = scan_results.res;
	for (uint8_t i = 0; i < scan_results.count; i++) {
		printk("%s(" FMT_MAC_ADDR ") | %-6s(%u) | %-4d | %-20s\n",
			   res[i].ssid, MAC_ADDR(res[i].mac),
			   wifi_band_txt(res[i].band), res[i].channel,
			   res[i].rssi, wifi_security_txt(res[i].security));
	}

exit:
	wifi_simple_scan_results_reset(&scan_results);
	wifi_simple_scan_results_deinit(&scan_results);
exit_nomem:
	net_mgmt_del_event_callback(&wifi_scan_cb);
	return ret;
}

void wifi_simple_init(void) {
	net_mgmt_init_event_callback(&inet_connectivity_cb, inet_connectivity_handler, L4_EVENT_MASK);
	net_mgmt_add_event_callback(&inet_connectivity_cb);

	net_mgmt_init_event_callback(&wifi_scan_cb, wifi_scan_event_handler, WIFI_SCAN_EVENT_MASK);

	flags = ATOMIC_INIT(0);
}

int wifi_simple_wait_online(void) {
	if (wifi_simple_is_connected()) {
		return 0;
	}

	return k_sem_take(&inet_ready, K_SECONDS(MAX_WIFI_INET_WAIT_SEC));
}

bool wifi_simple_is_connected(void) {
	return atomic_test_bit(&flags, WIFI_SIMPLE_CONNECTED);
}

/* sync SYS_CLOCK_REALTIME with sntp */
int sysclock_sync_sntp(void) {
	struct sntp_time ts;
	struct timespec tspec;

	int res = sntp_simple(CONFIG_MY_SNTP_SERVER, 3000, &ts);
	if (res < 0) {
		LOG_ERR("Cannot set time using SNTP");
		return res;
	}

	tspec.tv_sec = ts.seconds;
	tspec.tv_nsec = ((uint64_t)ts.fraction * NSEC_PER_SEC) >> 32;
	res = sys_clock_settime(SYS_CLOCK_REALTIME, &tspec);
	if (res < 0) {
		LOG_ERR("fail to set sysclock: %d", res);
	}

	return res;
}

bool sysclock_is_synced(void) {
	return atomic_test_bit(&flags, WIFI_SIMPLE_SNTP_RESYNCED);
}

static void sysclock_resync_work_handler(struct k_work *work) {
	struct k_work_delayable *dwork = k_work_delayable_from_work(work);

	int ret = sysclock_sync_sntp();
	if (ret < 0) {
		LOG_ERR("fail to resync clock: %d", ret);
		atomic_clear_bit(&flags, WIFI_SIMPLE_SNTP_RESYNCED);
	} else {
		LOG_INF("time resync");
		atomic_set_bit(&flags, WIFI_SIMPLE_SNTP_RESYNCED);
	}

	k_work_reschedule(dwork, ret < 0 ? K_SECONDS(5) : K_SECONDS(3600));
}
```
