## boards/waveshare/2_13inch_epaper_cloud_module/Kconfig.waveshare_2_13inch_epaper_cloud_module
```kconfig
# Waveshare 2.13 inch E-Paper cloud module board configuration

config BOARD_WAVESHARE_2_13INCH_EPAPER_CLOUD_MODULE
 	# The SoC of the original board has ESP32-WROOM-32, which has ESP32-D0WDQ6 SoC and it is NRND.
	# However, the SoC is somehow compatible with ESP32-D0WDV3
	select SOC_ESP32_D0WD_V3
	select SOC_ESP32_PROCPU if BOARD_WAVESHARE_2_13INCH_EPAPER_CLOUD_MODULE_ESP32_PROCPU
	select SOC_ESP32_APPCPU if BOARD_WAVESHARE_2_13INCH_EPAPER_CLOUD_MODULE_ESP32_APPCPU
```

## boards/waveshare/2_13inch_epaper_cloud_module/board.yml
```yaml
board:
  name: waveshare_2_13inch_epaper_cloud_module
  full_name: Waveshare 2.13inch E-Paper Cloud Module
  vendor: waveshare
  socs:
  - name: esp32
```

## boards/waveshare/2_13inch_epaper_cloud_module/waveshare_2_13inch_epaper_cloud_module_procpu_defconfig
```kconfig
# SPDX-License-Identifier: Apache-2.0

CONFIG_CONSOLE=y
CONFIG_SERIAL=y
CONFIG_UART_CONSOLE=y
CONFIG_GPIO=y

# ESP32-WROOM-32 is not supported by Zephyr OS
CONFIG_ESP32_USE_UNSUPPORTED_REVISION=y
```
